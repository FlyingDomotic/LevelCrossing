// Commands
#ifdef VERSION_FRANCAISE
    #define BARRIER1_CLOSE_ANGLE_COMMAND "AFB1"
    #define BARRIER1_OPEN_ANGLE_COMMAND "AOB1"
    #define BARRIER2_CLOSE_ANGLE_COMMAND "AFB2"
    #define BARRIER2_OPEN_ANGLE_COMMAND "AOB2"
    #define BARRIER3_CLOSE_ANGLE_COMMAND "AFB3"
    #define BARRIER3_OPEN_ANGLE_COMMAND "AOB3"
    #define BARRIER4_CLOSE_ANGLE_COMMAND "AFB4"
    #define BARRIER4_OPEN_ANGLE_COMMAND "AOB4"
    #define WAIT_BEFORE_CLOSE_COMMAND "AAF"
    #define DELAY_FOR_EACH_DEGREE_COMMAND "AACD"
    #define INERTIA_DEGREES_COUNT_COMMAND "NDI"
    #define DELAY_BEFORE_SECOND_CLOSE_COMMAND "AASF"
    #define LED_BLINK_TIME_COMMAND "DCL"
    #define DEBOUNCE_TIME_COMMAND "DAR"
    #define LEAVE_TRAIN_DELAY_COMMAND "TST"
    #ifdef DCC_PIN
        #define USE_DCC_COMMAND "DCC"
        #define MANUAL_MODE_DCC_ADDRESS_COMMAND "ADMM"
        #define OPEN_BARRIERS_DCC_ADDRESS_COMMAND "ADOB"
        #define CLOSE_BARRIERS_DCC_ADDRESS_COMMAND "ADFB"
    #endif
    #ifdef MP3_PIN
        #define CLOSE_SOUND_COMMAND "SF"
        #define PLAY_SOUND_COMMAND "TS"
        #define SOUND_VOLUME_COMMAND "V"
        #define SOUND_INCREMENT_DURATION_COMMAND "IS"
    #endif
    #define START_PROCESS_COMMAND "M"
    #define STOP_PROCESS_COMMAND "A"
    #define DISPLAY_ILS_STATE_COMMAND "E"
    #define OPEN_BARRIERS_COMMAND "O"
    #define CLOSE_BARRIERS_COMMAND "F"
    #define TOGGLE_DEBUG_COMMAND "D"
    #define INIT_COMMAND "INIT"
    #define DISPLAY_VARIABLES_COMMAND "AV"
#else
    #define BARRIER1_CLOSE_ANGLE_COMMAND "B1CA"
    #define BARRIER1_OPEN_ANGLE_COMMAND "B1OA"
    #define BARRIER2_CLOSE_ANGLE_COMMAND "B2CA"
    #define BARRIER2_OPEN_ANGLE_COMMAND "B2OA"
    #define BARRIER3_CLOSE_ANGLE_COMMAND "B3CA"
    #define BARRIER3_OPEN_ANGLE_COMMAND "B3OA"
    #define BARRIER4_CLOSE_ANGLE_COMMAND "B4CA"
    #define BARRIER4_OPEN_ANGLE_COMMAND "B4OA"
    #define WAIT_BEFORE_CLOSE_COMMAND "WBC"
    #define DELAY_FOR_EACH_DEGREE_COMMAND "DFED"
    #define INERTIA_DEGREES_COUNT_COMMAND "IDC"
    #define DELAY_BEFORE_SECOND_CLOSE_COMMAND "DBSC"
    #define LED_BLINK_TIME_COMMAND "LBT"
    #define DEBOUNCE_TIME_COMMAND "DT"
    #define LEAVE_TRAIN_DELAY_COMMAND "LTD"
    #ifdef DCC_PIN
        #define USE_DCC_COMMAND "DCC"
        #define MANUAL_MODE_DCC_ADDRESS_COMMAND "MADA"
        #define OPEN_BARRIERS_DCC_ADDRESS_COMMAND "OBDA"
        #define CLOSE_BARRIERS_DCC_ADDRESS_COMMAND "CBDA"
    #endif
    #ifdef MP3_PIN
        #define CLOSE_SOUND_COMMAND "CS"
        #define PLAY_SOUND_COMMAND "TS"
        #define SOUND_VOLUME_COMMAND "SV"
        #define SOUND_INCREMENT_DURATION_COMMAND "SI"
    #endif
    #define START_PROCESS_COMMAND "R"
    #define STOP_PROCESS_COMMAND "S"
    #define DISPLAY_ILS_STATE_COMMAND "IS"
    #define OPEN_BARRIERS_COMMAND "O"
    #define CLOSE_BARRIERS_COMMAND "C"
    #define TOGGLE_DEBUG_COMMAND "D"
    #define INIT_COMMAND "INIT"
    #define DISPLAY_VARIABLES_COMMAND "DV"
#endif
